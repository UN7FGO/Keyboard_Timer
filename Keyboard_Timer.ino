// http://un7fgo.gengen.ru (C) 2017
// 
// Краткое описание подключения выводов:
// - Экран 1602 подключен через I2C интерфейс на стандартных выводах А4 - SDA и А5 - SCL
// - Матричная клавиатура 4х4 подключена к выводам с 4 по 7 - колонки, с 8 по 11 - строки
// - Модуль реле подключаем к 3 выводу
// 
// Все назначения выводов (кроме интерфейса I2C) можно сменить в переменных
// 
// ---------------------------------------------
// Подключаем библиотеки для работы с Экраном по тгьеофейсу I2C
#include <Wire.h>
#include <LiquidCrystal_I2C.h>
// Создаем объект для работы с экраном
LiquidCrystal_I2C lcd(0x27,16,2);  /* или 0x3F. */

// ---------------------------------------------
// Тут описываем все необходимое для работы с матричной клавиатурой 
#include <Keypad.h>   // Подключаем библиотеку
// Задаем константы, которые будут нам необходимы в ходе работы
const byte ROWS = 4;  // 4 строки
const byte COLS = 4;  // 4 столбца
char keys[ROWS][COLS] = {
{'1','2','3','A'},
{'4','5','6','B'},
{'7','8','9','C'},
{'*','0','#','D'}
};
// Описываем контакты, к которым подключена клавиатура
byte colPins[COLS] = {7, 6, 5, 4};
byte rowPins[ROWS] = {8, 9, 10, 11};
// Создаем объект для работы с клавиатурой
Keypad keypad = Keypad( makeKeymap(keys), rowPins, colPins, ROWS, COLS );

// ---------------------------------------------
// глобальные константы

// код символя для клавиши BackSpace (по умолчанию - 35 "#")
byte BS_KEY = 35;
// код символя для клавиши Start/Stop (по умолчанию - 42 "*")
byte ST_KEY = 42;
// вывод для подключения управляющего реле
byte RELAY_PIN = 3;
// так как модули реле бывают прямые и инверсные, то заведем константы для ВКЛ-ВЫКЛ
byte RELAY_ON = HIGH;
byte RELAY_OFF = LOW;


// ---------------------------------------------
// глобальные переменные для работы программы

// символ получаемый с клавиатуры
char key;
// строка вводимых цифр, т.е. необходимое время для таймера
String input;
// секунды для обратного отсчета
long int seco;
// милисекунды для обработки
long int ms;

// ---------------------------------------------
// Процедура инициализации
void setup()
{
  pinMode(RELAY_PIN, OUTPUT);
  digitalWrite(RELAY_PIN, RELAY_OFF);
  lcd.begin();                  // Инициализация 
  lcd.backlight();              // Включаем подсветку
  input = "";
}

// ---------------------------------------------
// Основное тело программы
void loop()  // цикл
{
  // ставим курсор в левый верхний угол экрана
  lcd.setCursor(0, 0); 
  // Выводим индикацию текущего режима работы
  lcd.print("SETTING TIME   ");  
  // опрашиваем клаиатуру на предмет нажатой клавиши
  key = keypad.getKey();
  // если была нажата какая-либо клавиша, то...
  if (key){
    // символы от 48 до 57 - это цифры от 0 до 9 
    // если нажали цифру, то мы добавляем ее к уже введенным
    if (key>=char(48) and key<=char(57)){
      // но добавляем цифру только в том случае, если уже введено не более 8 знаков
      if (input.length()<8) {
        input = input + key;
      }
    }
    // При нажатии нужной клавиши стираем последний символ, как будто нажали BackSpace
    if (key==char(BS_KEY)){
      // Удалаем последний символ, если есть чего удалять
       if (input.length()>0) {
         input = input.substring(0, input.length()-1);
       }
    }
    // При нажатии на START/STOP переходим в режим обратного отсчета
    if (key==char(ST_KEY)){
      ms = 0;
      seco = input.toInt();
      while (seco>0) {
        digitalWrite(RELAY_PIN, RELAY_ON);
        // если прошло более 999 миллисекунд, то можно уменьшить счетчик оставшегося времени на 1
        if ((millis()-ms)>999) {
          // ставим курсор в левый верхний угол экрана
          lcd.setCursor(0, 0); 
          // Выводим индикацию текущего режима работы - ОБРАТНЫЙ ОТСЧЕТ
          lcd.print("COUNTDOWN      ");  
          // ставим курсор в начало второй строки
          lcd.setCursor(0, 1); 
          // выводим на экран оставшееся время
          lcd.print(String(seco)+"  ");
          seco = seco - 1;
          ms = millis();
        }
        // продолжаем опрашивать клавиатуру
        key = keypad.getKey();
        if (key){
          if (key==char(ST_KEY)){
            digitalWrite(RELAY_PIN, RELAY_OFF);
            // ставим курсор в левый верхний угол экрана
            lcd.setCursor(0, 0); 
            // Выводим индикацию текущего режима работы - ПАУЗА
            lcd.print("PAUSE          ");  
            key = ' ';
            // ждем, пока снова не нажмут клавишу Start/Stop
            while (key!=char(ST_KEY)) {
              key = keypad.getKey();
              // Если нажали клавишу BackSpace, то переходим опять на установку времени
              if (key==char(BS_KEY)) {
                seco = 0;
                key=char(ST_KEY);                
              }
            }
          }
          
        }

      }
      digitalWrite(RELAY_PIN, RELAY_OFF);
    }
    // ставим курсор в начало второй строки
    lcd.setCursor(0, 1); 
    // выводим на экран введенное или исправленное число
    lcd.print(input+"  ");
  }
  
}

